## main/Kconfig.projbuild
```kconfig
menu "HFP Example Configuration"
    config EXAMPLE_SSP_ENABLED
        bool "Secure Simple Pairing"
        depends on BT_CLASSIC_ENABLED
        default y
        help
            This enables the Sec
            ure Simple Pairing. If disable this option,
            Bluedroid will only support Legacy Pairing


endmenu

menu "Ma Bell Gateway"
    config MA_BELL_TONE_TEST
        bool "Tone test codes dialed from the cell phone"
        default y
        help
            Bench test for the call-progress tones. Dialing *1 to *6 on the
            paired cell phone plays a tone on the I2S output (dial tone,
            ringback, busy, reorder, off-hook warning, stutter dial tone),
            *9 plays each in turn and *0 stops. The gateway hangs the call
            up while it is still dialing. Turn this off once off-hook
            detection drives the tones.

    config MA_BELL_SPEAKER_RING
        bool "Ring on the speaker for an incoming call"
        default y
        help
            Plays an electronic ringer (a 1000 / 1250 Hz warble, 2s on /
            4s off) on the I2S output while the cell phone has an incoming
            call, and stops when the call is answered, declined or
            missed. For the bench, before the line interface rings a real
            bell. Turn this off once the bell rings.
endmenu
```
